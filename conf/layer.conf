## conf/layer.conf
```bitbake
#Add the layer's core metadata (configuration, machines, and classes)
#to the BBPATH.
BBPATH .= ":${LAYERDIR}"

#Add the individual recipes this layer will be using to the list of
#available recipe files...
BBFILES += " \
  ${LAYERDIR}/recipes-*/*/*.bb \
	${LAYERDIR}/recipes-*/*/*.bbappend \
"

#... and specify some information about the layer.
BBFILE_COLLECTIONS += "echi-debug"
BBFILE_PATTERN_echi-debug = "^${LAYERDIR}/"

#Depending on the other layers in your install, you may need to adjust
#the value below.
BBFILE_PRIORITY_echi-debug = "6"
```
